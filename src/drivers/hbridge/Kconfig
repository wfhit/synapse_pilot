## src/drivers/hbridge/Kconfig
```kconfig
menuconfig DRIVERS_HBRIDGE
	bool "HBridge Driver"
	default n
	help
	  Enable support for H-Bridge motor drivers with PWM speed control
	  and GPIO direction control. Supports multiple instances with
	  dual channels each.
```

## src/drivers/limit_sensor/Kconfig
```kconfig
menuconfig DRIVERS_LIMIT_SENSOR
	bool "limit_sensor"
	default n
	---help---
		Enable support for Limit Sensor driver.

		This module provides GPIO-based limit switch monitoring for
		hydraulic components with support for up to 8 sensor instances,
		optional dual-switch redundancy, debouncing, and safety integration.
```

## src/drivers/mag_encoder/Kconfig
```kconfig
menu "Magnetic Encoders"
	menuconfig COMMON_MAG_ENCODER
		bool "Common Magnetic Encoders"
		default n
		select DRIVERS_MAG_ENCODER_AS5600
		---help---
			Enable default set of magnetic encoder drivers

	rsource "*/Kconfig"
endmenu
```

## src/drivers/mag_encoder/as5600/Kconfig
```kconfig
menuconfig DRIVERS_MAG_ENCODER_AS5600
	bool "AS5600 magnetic encoder"
	default n
	---help---
		Enable support for AS5600 magnetic rotary position sensor
```

## src/drivers/quadrature_encoder/Kconfig
```kconfig
menuconfig DRIVERS_QUADRATURE_ENCODER
	bool "quadrature encoder"
	default n
	---help---
		Enable support for GPIO-based quadrature encoders

if DRIVERS_QUADRATURE_ENCODER

config DRIVERS_QUADRATURE_ENCODER_DEBUG
	bool "Enable debug output"
	default n
	---help---
		Enable additional debug output for quadrature encoder

endif # DRIVERS_QUADRATURE_ENCODER
```

## src/drivers/smart_servo/Kconfig
```kconfig
menu "Smart Servos"
	menuconfig COMMON_SMART_SERVO
		bool "Common Smart Servos"
		default n
		select DRIVERS_SMART_SERVO_ST3215
		---help---
			Enable default set of smart servo drivers

	rsource "*/Kconfig"
endmenu
```

## src/drivers/smart_servo/st3215/Kconfig
```kconfig
menuconfig DRIVERS_SMART_SERVO_ST3215
	bool "ST3215 servo driver"
	default n
	---help---
		Enable support for ST3215 smart servo driver
```

## src/systemcmds/gen_serial_test/Kconfig
```kconfig
menuconfig SYSTEMCMDS_GEN_SERIAL_TEST
	bool "gen_serial_test"
	default n
	---help---
		Enable support for general serial port test utility

		This command provides comprehensive testing capabilities for any
		serial port used in wheel loader serial communication systems.

		Test modes include:
		- Basic connectivity test
		- Loopback test (requires hardware loopback)
		- Echo test (requires external echo device)
		- Pattern transmission test
		- Continuous transmission test
```

## src/systemcmds/wk2132_test/Kconfig
```kconfig
menuconfig SYSTEMCMDS_WK2132_TEST
	bool "wk2132_test"
	default n
	---help---
		Enable support for WK2132 UART test utility

		This command provides comprehensive testing capabilities for the WK2132
		I2C-to-UART bridge used in wheel loader serial communication systems.

		Test modes include:
		- Basic connectivity test
		- Loopback test (requires hardware loopback)
		- Echo test (requires external echo device)
		- Pattern transmission test
		- Continuous transmission test
```

## src/wheel_loader/Kconfig
```kconfig
# Wheel Loader Specific Modules

menuconfig WHEEL_LOADER_MODULES
	bool "Wheel Loader Modules"
	default n
	help
		Enable wheel loader specific modules for articulated chassis control,
		boom/tilt control, lamp controllers, and system management.

if WHEEL_LOADER_MODULES

rsource "articulated_chassis/Kconfig"
rsource "boom_control/Kconfig"
rsource "tilt_control/Kconfig"
rsource "load_lamp_controller/Kconfig"
rsource "driver_lamp_controller/Kconfig"
rsource "nav_lamp_controller/Kconfig"
rsource "uorb_uart_bridge/Kconfig"
rsource "uorb_uart_proxy/Kconfig"
rsource "vla_proxy/Kconfig"
rsource "operation_mode/Kconfig"
rsource "arm_manager/Kconfig"
rsource "health_monitor/Kconfig"
rsource "interactor_interface/Kconfig"
rsource "strategy_executor/Kconfig"

endif # WHEEL_LOADER_MODULES
```

## src/wheel_loader/arm_manager/Kconfig
```kconfig
menuconfig WHEEL_LOADER_ARM_MANAGER
	bool "arm_manager"
	default n
	---help---
		Enable support for arm manager module
		Manages the arming/disarming state and safety checks for wheel loader systems.
```

## src/wheel_loader/articulated_chassis/Kconfig
```kconfig
menuconfig MODULES_ARTICULATED_CHASSIS
	bool "articulated_chassis"
	default n
	help
		Enable support for articulated chassis control system for wheel loaders.
		This includes wheel control, steering, traction management, safety monitoring,
		and advanced terrain adaptation capabilities.

if MODULES_ARTICULATED_CHASSIS

config ARTICULATED_CHASSIS_WHEEL_CONTROLLER
	bool "Enable wheel controller"
	default y
	help
		Unified wheel controller for front and rear wheel velocity control
		with PID feedback and quad encoder integration.

config ARTICULATED_CHASSIS_STEERING_CONTROLLER
	bool "Enable steering controller"
	default y
	help
		Articulated chassis steering controller with PID position control
		and servo PWM output for hydraulic steering systems.

config ARTICULATED_CHASSIS_TRACTION_CONTROL
	bool "Enable traction control"
	default y
	help
		Advanced traction control for articulated wheel loader
		with slip estimation and dynamic torque distribution for mining operations.

endif # MODULES_ARTICULATED_CHASSIS
```

## src/wheel_loader/articulated_chassis/drivetrain_controller/Kconfig
```kconfig
menuconfig WHEEL_LOADER_ARTICULATED_CHASSIS_DRIVETRAIN_CONTROLLER
	bool "Drivetrain Controller"
	default n
	---help---
		Enable closed-loop drivetrain controller for articulated wheel loader.

		This module provides individual wheel speed control using:
		- PID control with quadrature encoder feedback
		- DRV8701 H-bridge motor driver interface
		- Low-pass filtering for noise reduction
		- Safety monitoring and emergency stop
		- Multi-instance support for front/rear axles
		- Configurable control parameters via PX4 parameter system

		The controller accepts speed setpoints and maintains precise wheel
		velocity control for traction optimization and stable operation
		in mining environments.
```

## src/wheel_loader/articulated_chassis/steering_controller/Kconfig
```kconfig
menuconfig WHEEL_LOADER_STEERING_CONTROLLER
	bool "steering_controller"
	default n
	---help---
		Enable articulated chassis steering controller with PID position control
		and servo PWM output for hydraulic steering systems.
		
		Provides precise steering angle control for articulated wheel loaders
		with feedback from magnetic encoders and hydraulic valve control.
```

## src/wheel_loader/articulated_chassis/traction_controller/Kconfig
```kconfig
menuconfig MODULES_ARTICULATED_CHASSIS_TRACTION_CONTROLLER
	bool "Traction Controller"
	default n
	help
		Enable advanced traction control for articulated wheel loader
		with slip estimation and dynamic torque distribution for mining operations
```

## src/wheel_loader/boom_control/Kconfig
```kconfig
menuconfig MODULES_BOOM_CONTROL
	bool "boom control"
	default n
	---help---
		Enable support for boom control module
```

## src/wheel_loader/driver_lamp_controller/Kconfig
```kconfig
menuconfig MODULES_DRIVER_LAMP_CONTROLLER
	bool "driver_lamp_controller"
	default n
	---help---
		Enable support for driver lamp controller (turn signals and reverse lamps)
```

## src/wheel_loader/health_monitor/Kconfig
```kconfig
menuconfig MODULES_HEALTH_MONITOR
	bool "health_monitor"
	default n
	---help---
		Enable support for health monitor module
		Monitors system health, sensor status, and actuator performance for wheel loader.
```

## src/wheel_loader/interactor_interface/Kconfig
```kconfig
menuconfig MODULES_INTERACTOR_INTERFACE
	bool "interactor_interface"
	default n
	---help---
		Enable support for interactor interface module
		Provides interface for external interaction and control of wheel loader functions.
```

## src/wheel_loader/load_lamp_controller/Kconfig
```kconfig
menuconfig WHEEL_LOADER_LOAD_LAMP_CONTROLLER
	bool "load_lamp_controller"
	default n
	---help---
		Enable support for load lamp controller module
```

## src/wheel_loader/nav_lamp_controller/Kconfig
```kconfig
config WHEEL_LOADER_NAV_LAMP_CONTROLLER
	bool "Navigation Lamp Controller Module"
	default n
	help
	  Enable the Navigation Lamp Controller module, which receives lamp state commands
	  and outputs trigger pulses to change the lamp state sequentially.

	  Note: This module requires BOARD_HAS_STATUS_LAMP_TRIGGER to be defined
	  in the board configuration. On unsupported boards, the module will start
	  but GPIO operations will be disabled.
```

## src/wheel_loader/operation_mode/Kconfig
```kconfig
menuconfig MODULES_OPERATION_MODE
	bool "operation_mode"
	default n
	---help---
		Enable support for operation mode manager
```

## src/wheel_loader/strategy_executor/Kconfig
```kconfig
menuconfig MODULES_STRATEGY_EXECUTOR
	bool "strategy_executor"
	default n
	---help---
		Enable support for strategy executor module
		Executes high-level automation strategies and manages failsafe behaviors
		for autonomous wheel loader operations.
```

## src/wheel_loader/tilt_control/Kconfig
```kconfig
menuconfig MODULES_TILT_CONTROL
	bool "tilt_control"
	default n
	---help---
		Enable support for tilt control module

		This module provides advanced tilt control for wheel loader applications
		including kinematic calculations, motion planning, boom compensation,
		and state management with calibration.

if MODULES_TILT_CONTROL

config TILT_CONTROL_BOOM_COMPENSATION
	bool "Enable boom compensation"
	default y
	---help---
		Enable boom angle compensation to maintain tilt orientation
		relative to ground when boom moves.

config TILT_CONTROL_CALIBRATION
	bool "Enable automatic calibration"
	default y
	---help---
		Enable automatic calibration sequence to determine actuator
		limits and tilt angle ranges.

config TILT_CONTROL_PERFORMANCE_MONITORING
	bool "Enable performance monitoring"
	default y
	---help---
		Enable performance metrics collection for control system
		analysis and tuning.

endif # MODULES_TILT_CONTROL
```
