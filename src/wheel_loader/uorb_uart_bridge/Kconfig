## src/wheel_loader/uorb_uart_bridge/Kconfig
```kconfig
menuconfig WHEEL_LOADER_UORB_UART_BRIDGE
	bool "uorb_uart_bridge"
	default n
	---help---
		Enable support for uORB UART Bridge module.

		This module provides transparent uORB messaging over UART
		for distributed systems. It runs on the X7+ main board and
		forwards uORB messages to/from NXT controller boards.

menuconfig USER_UORB_UART_BRIDGE
	bool "uorb_uart_bridge running as userspace module"
	default n
	depends on BOARD_PROTECTED && WHEEL_LOADER_UORB_UART_BRIDGE
	---help---
		Put uorb_uart_bridge in userspace memory
```

## src/wheel_loader/uorb_uart_proxy/Kconfig
```kconfig
menuconfig MODULES_UORB_UART_PROXY
	bool "uorb_uart_proxy"
	default n
	---help---
		Enable support for uORB UART Proxy module.

		This module provides transparent uORB messaging over UART
		for distributed systems. It runs on NXT-Dual controller boards
		and communicates with the X7+ main board.

menuconfig USER_UORB_UART_PROXY
	bool "uorb_uart_proxy running as userspace module"
	default n
	depends on BOARD_PROTECTED && MODULES_UORB_UART_PROXY
	---help---
		Put uorb_uart_proxy in userspace memory
```

## src/wheel_loader/vla_proxy/Kconfig
```kconfig
menuconfig WHEEL_LOADER_VLA_PROXY
	bool "VLA Proxy Driver"
	default n
	---help---
		Enable support for VLA (Vision-Language-Action) proxy driver.
		This driver provides a UART-based interface between PX4 and a VLA model,
		handling bidirectional communication for autonomous wheel loader operation.

		Features:
		- Sends wheel loader status (position, velocity, boom, bucket, chassis) via UART
		- Receives 6DOF trajectory waypoints from VLA model
		- Robust packet protocol with headers (0xAA 0x55), checksums, and timeouts
		- Runs at 50Hz with configurable status send rate (default 20Hz)
		- Waypoint buffering for smooth trajectory execution

		The driver follows the ST3215 servo driver pattern for reliable UART communication.
```
